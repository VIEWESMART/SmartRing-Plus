## examples/esp-idf/03_wifi/main/Kconfig.projbuild
```kconfig
menu "Example Configuration"

    config EXAMPLE_WIFI_SSID
        string "WiFi SSID"
        default "myssid"
        help
            Target AP SSID. Change via idf.py menuconfig.

    config EXAMPLE_WIFI_PASSWORD
        string "WiFi Password"
        default "mypassword"
        help
            Target AP password. Empty for open networks.

endmenu
```

## examples/esp-idf/04_lvgl_port/sdkconfig.defaults
```kconfig
# SmartRing-Plus example — ESP32-S3-N16R8
CONFIG_IDF_TARGET="esp32s3"
CONFIG_ESPTOOLPY_FLASHSIZE_16MB=y
CONFIG_SPIRAM=y
CONFIG_SPIRAM_MODE_OCT=y
CONFIG_SPIRAM_SPEED_80M=y
CONFIG_ESP_CONSOLE_USB_SERIAL_JTAG=y
CONFIG_ESP_MAIN_TASK_STACK_SIZE=8192
CONFIG_ESP_SYSTEM_EVENT_TASK_STACK_SIZE=4096
CONFIG_FREERTOS_HZ=1000
CONFIG_CODEC_I2C_BACKWARD_COMPATIBLE=n
CONFIG_PARTITION_TABLE_CUSTOM=y
CONFIG_PARTITION_TABLE_CUSTOM_FILENAME="partitions.csv"
CONFIG_LV_OS_FREERTOS=y
CONFIG_LV_USE_CLIB_MALLOC=y
CONFIG_LV_USE_CLIB_STRING=y
CONFIG_LV_USE_CLIB_SPRINTF=y
CONFIG_LV_DEF_REFR_PERIOD=15
CONFIG_LV_OBJ_STYLE_CACHE=y
CONFIG_LV_DRAW_SW_DRAW_UNIT_CNT=2
CONFIG_LV_FONT_MONTSERRAT_14=y
CONFIG_LV_FONT_MONTSERRAT_16=y
CONFIG_LV_FONT_MONTSERRAT_20=y

CONFIG_LV_BUILD_DEMOS=y
CONFIG_LV_USE_DEMO_WIDGETS=y
CONFIG_LV_FONT_MONTSERRAT_12=y
CONFIG_LV_FONT_MONTSERRAT_18=y
CONFIG_LV_FONT_MONTSERRAT_24=y
CONFIG_LV_USE_FLEX=y
CONFIG_LV_USE_GRID=y
```

## examples/esp-idf/10_full-device/sdkconfig.defaults
```kconfig
# smartring_plus_full_device — SmartRing-Plus 整机演示
# Author: Ayang / SHENZHEN VIEWE TECHNOLOGY CO.,LTD
CONFIG_IDF_TARGET="esp32s3"

# 16MB Flash
CONFIG_ESPTOOLPY_FLASHSIZE_16MB=y

# 8MB Octal PSRAM
CONFIG_SPIRAM=y
CONFIG_SPIRAM_MODE_OCT=y
CONFIG_SPIRAM_SPEED_80M=y

# USB-Serial-JTAG 控制台
CONFIG_ESP_CONSOLE_USB_SERIAL_JTAG=y

# main 任务栈
CONFIG_ESP_MAIN_TASK_STACK_SIZE=8192

# 系统事件任务栈（WiFi 事件回调，默认 2304 过小）
CONFIG_ESP_SYSTEM_EVENT_TASK_STACK_SIZE=4096

# FreeRTOS 1ms tick
CONFIG_FREERTOS_HZ=1000

# esp_codec_dev 新 I2C 驱动
CONFIG_CODEC_I2C_BACKWARD_COMPATIBLE=n

# 大应用分区
CONFIG_PARTITION_TABLE_CUSTOM=y
CONFIG_PARTITION_TABLE_CUSTOM_FILENAME="partitions.csv"

# WiFi
CONFIG_ESP_WIFI_ENABLED=y
CONFIG_ESP_WIFI_STA_DISCONNECTED_PM_ENABLE=n
CONFIG_LWIP_IPV6=y

# SNTP
CONFIG_LWIP_SNTP_MAX_SERVERS=1

# FAT 长文件名（录音目录 Recordings、带时间戳的 wav 文件必需）
CONFIG_FATFS_LFN_HEAP=y
CONFIG_FATFS_MAX_LFN=255

# LVGL（配合 esp_lvgl_adapter 推荐配置）
CONFIG_LV_OS_FREERTOS=y
CONFIG_LV_USE_CLIB_MALLOC=y
CONFIG_LV_USE_CLIB_STRING=y
CONFIG_LV_USE_CLIB_SPRINTF=y
CONFIG_LV_DEF_REFR_PERIOD=15
CONFIG_LV_OBJ_STYLE_CACHE=y
CONFIG_LV_DRAW_SW_DRAW_UNIT_CNT=2

# LVGL 字体
CONFIG_LV_FONT_MONTSERRAT_14=y
CONFIG_LV_FONT_MONTSERRAT_16=y
CONFIG_LV_FONT_MONTSERRAT_20=y
CONFIG_LV_FONT_MONTSERRAT_28=y
CONFIG_LV_FONT_MONTSERRAT_48=y

# LVGL SD 卡文件系统（字母 S -> /sdcard/）
CONFIG_LV_USE_FS_STDIO=y
CONFIG_LV_FS_STDIO_LETTER=83
CONFIG_LV_FS_STDIO_PATH="/sdcard/"
CONFIG_LV_FS_STDIO_CACHE_SIZE=512

# esp_lvgl_adapter：相册已单独依赖 esp_lv_decoder，此处关闭可选模块避免重复
# CONFIG_ESP_LVGL_ADAPTER_ENABLE_DECODER is not set
# CONFIG_ESP_LVGL_ADAPTER_ENABLE_FS is not set
```
